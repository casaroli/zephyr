## boards/pimoroni/pico_plus2/Kconfig.pico_plus2
```kconfig
# Copyright (c) 2024 TOKITA Hiroshi
# SPDX-License-Identifier: Apache-2.0

config BOARD_PICO_PLUS2
	select SOC_RP2350B_HAZARD3 if BOARD_PICO_PLUS2_RP2350B_HAZARD3
	select SOC_RP2350B_M33 if BOARD_PICO_PLUS2_RP2350B_M33 \
        || BOARD_PICO_PLUS2_RP2350B_M33_W \
        || BOARD_PICO_PLUS2_RP2350B_M33_MCUBOOT \
        || BOARD_PICO_PLUS2_RP2350B_M33_W_MCUBOOT
	select MEMC
	select MEMC_RP2350_PSRAM
```

## drivers/memc/Kconfig.rp2350
```kconfig
config MEMC_RP2350_PSRAM
	bool "RP2350 external PSRAM"
	default y if BOARD_PICO_PLUS2
	help
	  This enables support for an external SPI PSRAM chip, connected in
	  parallel with the main SPI flash chip.
```

## dts/bindings/fs/zephyr,fstab,tmpfs.yaml
```yaml
# Copyright (C) 2025 Atym, Inc.
# SPDX-License-Identifier: Apache-2.0

description: |
  Description of pre-defined tmpfs file systems.

compatible: "zephyr,fstab,tmpfs"

include: zephyr,fstab-common.yaml
```

## dts/bindings/memory-controllers/rp,rp2350-qmi-psram.yaml
```yaml
# Copyright (c) 2025 Marco Casaroli
# SPDX-License-Identifier: Apache-2.0

description: |
  RP2350 QSPI PSRAM.

compatible: "raspberrypi,rp2350-qmi-psram"

include:
  - base.yaml
  - zephyr,memory-region.yaml
  - pinctrl-device.yaml

properties:
  max-frequency:
    type: int
    required: true
    description: Maximum clock frequency of device's QSPI interface in Hz

  cooldown:
    type: int
    required: true
    enum:
      - 0
      - 1
      - 2
      - 3

  pagebreak:
    type: int
    default: 5
    description: |
      Pagebreak value
      - 0x0 -> NONE: No page boundary is enforced
      - 0x1 -> 256: Break bursts crossing a 256-byte page boundary
      - 0x2 -> 1024: Break bursts crossing a 1024-byte quad-page boundary
      - 0x3 -> 4096: Break bursts crossing a 4096-byte sector boundary
    enum:
      - 0
      - 1
      - 2
      - 3

  select-setup:
    type: int
    default: 0
    enum:
      - 0
      - 1

  select-hold:
    type: int
    default: 0
    enum:
      - 0
      - 1
      - 2
      - 3

  max-select:
    type: int
    required: true

  min-deselect:
    type: int
    required: true

  rxdelay:
    type: int
    required: true

  clkdiv:
    type: int
    required: true

child-binding:
  description: read or write configuration
  properties:
    dtr:
      type: int
      default: 0
      enum:
        - 0
        - 1

    dummy_len:
      type: int
      default: 0x0
      description: |
        - 0x0 -> NONE: No dummy phase
        - 0x1 -> 4: 4 dummy bits
        - 0x2 -> 8: 8 dummy bits
        - 0x3 -> 12: 12 dummy bits
        - 0x4 -> 16: 16 dummy bits
        - 0x5 -> 20: 20 dummy bits
        - 0x6 -> 24: 24 dummy bits
        - 0x7 -> 28: 28 dummy bits
      enum:
        - 0x0
        - 0x1
        - 0x2
        - 0x3
        - 0x4
        - 0x5
        - 0x6
        - 0x7

    suffix_len:
      type: int
      default: 0x0
      description: |
        - 0x0 -> NONE: No suffix
        - 0x2 -> 8: 8-bit suffix
      enum:
        - 0x0
        - 0x2

    prefix_len:
      type: int
      default: 0x0
      description: |
        - 0x0 -> NONE: No prefix
        - 0x1 -> 8: 8-bit prefix
      enum:
        - 0x0
        - 0x1

    data_width:
      type: int
      required: true
      description: |
        - 0x0 -> S: Single width
        - 0x1 -> D: Dual width
        - 0x2 -> Q: Quad width

    dummy_width:
      type: int
      required: true
      description: |
        - 0x0 -> S: Single width
        - 0x1 -> D: Dual width
        - 0x2 -> Q: Quad width

    suffix_width:
      type: int
      required: true
      description: |
        - 0x0 -> S: Single width
        - 0x1 -> D: Dual width
        - 0x2 -> Q: Quad width

    addr_width:
      type: int
      required: true
      description: |
        - 0x0 -> S: Single width
        - 0x1 -> D: Dual width
        - 0x2 -> Q: Quad width

    prefix_width:
      type: int
      required: true
      description: |
        - 0x0 -> S: Single width
        - 0x1 -> D: Dual width
        - 0x2 -> Q: Quad width

    suffix:
      type: int
      default: 0x00

    prefix:
      type: int
      default: 0x00
```

## subsys/fs/tmpfs/Kconfig
```kconfig
# Copyright (c) 2025 Atym, Inc.
# SPDX-License-Identifier: Apache-2.0

# tmpfs file system

config FILE_SYSTEM_TMPFS
	bool "tmpfs file system support"
	depends on FILE_SYSTEM_LIB_LINK
	help
	  Enable tmpfs file system support.

module = TMPFS
module-str = tmpfs
source "subsys/logging/Kconfig.template.log_config"

if FILE_SYSTEM_TMPFS

menu "tmpfs file system Settings"
	visible if FILE_SYSTEM_TMPFS

config FILE_SYSTEM_TMPFS_BLOCKSIZE
	int "Reported block size"
	default 512
	help
	  Various queries expect the file system to report resources in units
	  of blocks.  There are, of course, no blocks with the TMPFS.  This
	  options is available to control how sizes are reported.  For very
	  small TMPFS systems, you might want to set this to something smaller
	  the usual 512 bytes.

config FILE_SYSTEM_TMPFS_DIRECTORY_ALLOCGUARD
	int "Directory object over-allocation"
	default 64
	help
	  In order to avoid frequent reallocations, a little more memory than
	  needed is always allocated.  This permits the directory to grow
	  without so many reallocations.

config FILE_SYSTEM_TMPFS_DIRECTORY_FREEGUARD
	int "Directory under free"
	default 128
	help
	  In order to avoid frequent reallocations, a lot of free memory has
	  to be available before a directory entry shrinks (via reallocation)
	  little more memory than needed is always allocated.  This permits
	  the directory to shrink without so many reallocations.

config FILE_SYSTEM_TMPFS_FILE_ALLOCGUARD
	int "File object over-allocation"
	default 512
	help
	  In order to avoid frequent reallocations, a little more memory than
	  needed is always allocated.  This permits the file to grow without
	  so many reallocations.

	  You will probably want to use smaller value than the default on tiny
	  TMFPS systems.

config FILE_SYSTEM_TMPFS_FILE_FREEGUARD
	int "File under free"
	default 1024
	help
	  In order to avoid frequent reallocations, a lot of free memory has
	  to be available before a directory entry shrinks (via reallocation)
	  little more memory than needed is always allocated.  This permits
	  the file to shrink without so many reallocations.

DT_COMPAT_ZEPHYR_FSTAB_TMPFS := zephyr,fstab,tmpfs
config TMPFS_FSTAB_AUTOMOUNT
	bool "Support for fstab auto-mounting"
	depends on $(dt_compat_enabled,$(DT_COMPAT_ZEPHYR_FSTAB_TMPFS))
	help
	  This option enables tmpfs support for the devicetree fstab auto-mounting
	  functionality.

config TMPFS_TMP_AUTOMOUNT
	bool "Mount /tmp automatically"
	help
	  This option enables auto mount of a tmpfs file system on /tmp.

endmenu
endif
```

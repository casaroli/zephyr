## CMakeLists.txt
```
# SPDX-License-Identifier: Apache-2.0

cmake_minimum_required(VERSION 3.20.0)

find_package(Zephyr REQUIRED HINTS $ENV{ZEPHYR_BASE})
project(tmpfs)

target_sources(app PRIVATE src/main.c)
```

## sample.yaml
```
sample:
  description: fatfs tmpfs sample
  name: fatfs tmpfs
common:
  tags: posix
  integration_platforms:
    - native_sim
    - qemu_riscv64
  harness: console
  harness_config:
    type: multi_line
    ordered: true
    regex:
      - "sysname\\[7\\]: Zephyr"
      - "nodename\\[\\d+\\]: .*"
      - "release\\[\\d+\\]: \\d+\\.\\d+\\.\\d+"
      - "version\\[\\d+\\]: .*"
      - "machine\\[\\d+\\]: .*"
tests:
  sample.filesystem.tmpfs.fstab:
    tags: uname
```

## prj.conf
```kconfig
CONFIG_POSIX_API=y
CONFIG_SHELL=y
CONFIG_MP_MAX_NUM_CPUS=1
CONFIG_FILE_SYSTEM=y
CONFIG_FILE_SYSTEM_SHELL=y
CONFIG_FILE_SYSTEM_SHELL_TEST_COMMANDS=y
CONFIG_HEAP_MEM_POOL_SIZE=131072
CONFIG_ZVFS_OPEN_MAX=16
CONFIG_FILE_SYSTEM_TMPFS=y
CONFIG_TMPFS_FSTAB_AUTOMOUNT=y
CONFIG_TMPFS_TMP_AUTOMOUNT=y
```

## app.overlay
```dts
/ {
	fstab {
		tmpfs {
			compatible = "zephyr,fstab,tmpfs";
			automount;
			mount-point = "/tmp2";
		};
	};
};
```

## src/main.c
```c
/*
 * Copyright (c) 2025 Atym, Inc.
 *
 * SPDX-License-Identifier: Apache-2.0
 */

int main(void)
{
	return 0;
}
```

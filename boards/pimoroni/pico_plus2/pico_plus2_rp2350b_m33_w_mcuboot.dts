/*
 * Copyright (c) 2025 Magpie Embedded
 *
 * SPDX-License-Identifier: Apache-2.0
 */

/dts-v1/;

/* The build system assumes that there's a cpucluster-specific file.
 *
 * This file provides composition of the device tree:
 * 1. The common features of the SoC
 * 2. Core-specific configuration.
 * 3. Board-specific configuration.
 */
#include <raspberrypi/rpi_pico/rp2350b.dtsi>
#include <raspberrypi/rpi_pico/m33.dtsi>
#include "pico_plus2.dtsi"
#include "pico_plus2-w-wifi.dtsi"

/* Partitioning for the RP2350B-M33 board using 16M flash.
 */
#include <raspberrypi/partitions_16M_sysbuild.dtsi>

/ {
	chosen {
		zephyr,code-partition = &slot0_partition;
	};
};

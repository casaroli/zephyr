## CMakeLists.txt
```
# SPDX-License-Identifier: Apache-2.0

cmake_minimum_required(VERSION 3.20.0)

find_package(Zephyr REQUIRED HINTS $ENV{ZEPHYR_BASE})
project(posix_dirfd)

target_sources(app PRIVATE src/main.c)
```

## sample.yaml
```
sample:
  description: posix dirfd sample
  name: posix dirfd
common:
  tags: posix
  integration_platforms:
    - native_sim
    - qemu_riscv64
  harness: console
  harness_config:
    type: multi_line
    ordered: true
    regex:
      - "sysname\\[7\\]: Zephyr"
      - "nodename\\[\\d+\\]: .*"
      - "release\\[\\d+\\]: \\d+\\.\\d+\\.\\d+"
      - "version\\[\\d+\\]: .*"
      - "machine\\[\\d+\\]: .*"
tests:
  sample.posix.dirfd:
    tags: uname
```

## prj.conf
```kconfig
CONFIG_POSIX_API=y
CONFIG_SHELL=y
CONFIG_POSIX_UNAME_SHELL=y
CONFIG_MP_MAX_NUM_CPUS=1
CONFIG_FLASH=y
CONFIG_FLASH_MAP=y
CONFIG_FILE_SYSTEM=y
CONFIG_FILE_SYSTEM_LITTLEFS=y
CONFIG_FILE_SYSTEM_SHELL=y
CONFIG_FILE_SYSTEM_MKFS=y
CONFIG_FILE_SYSTEM_SHELL_TEST_COMMANDS=y
CONFIG_HEAP_MEM_POOL_SIZE=131072
CONFIG_ZVFS_OPEN_MAX=16
```

## boards/pico_plus2_rp2350b_m33_w.overlay
```dts
//#include <raspberrypi/partitions_4M_sysbuild.dtsi>
//
/// {
//	chosen {
//		zephyr,code-partition = &slot0_partition;
//	};
//};
//
&flash0 {
	partitions {
		compatible = "fixed-partitions";
		#address-cells = <1>;
		#size-cells = <1>;

//  	user_data_partition: partition@400000 {
//  		label = "user-data";
//  		reg = <0x00400000 0x00400000>;
//  	};
  	user_data_partition: storage_partition: partition@600000 {
  		label = "storage";
//  		reg = <0x00600000 0x00200000>;
        reg = <0x410000 0x800000>;
  	};
	};
};
```

## src/main.c
```c
/*
 * Copyright (c) 2023 Meta
 *
 * SPDX-License-Identifier: Apache-2.0
 */

#include <zephyr/logging/log.h>
#include <stdio.h>
#include <sys/utsname.h>
// #include <sys/types.h>
#include <dirent.h>
#include <zephyr/fs/fs.h>
#include <zephyr/fs/littlefs.h>
#include <fcntl.h>
#include <zephyr/drivers/flash.h>
#include <zephyr/storage/flash_map.h>
#include <unistd.h>

#define DIRECTORY_NAME "/lfs/cfs"

LOG_MODULE_REGISTER(dirfd_sample, 4);

static int littlefs_flash_erase(unsigned int id)
{
	const struct flash_area *pfa;
	int rc;

	rc = flash_area_open(id, &pfa);
	if (rc < 0) {
		LOG_ERR("FAIL: unable to find flash area %u: %d\n",
			id, rc);
		return rc;
	}

	LOG_PRINTK("Area %u at 0x%x on %s for %u bytes\n",
		   id, (unsigned int)pfa->fa_off, pfa->fa_dev->name,
		   (unsigned int)pfa->fa_size);

	/* Optional wipe flash contents */
	if (IS_ENABLED(CONFIG_APP_WIPE_STORAGE)) {
		rc = flash_area_flatten(pfa, 0, pfa->fa_size);
		LOG_ERR("Erasing flash area ... %d", rc);
	}

	flash_area_close(pfa);
	return rc;
}
#define PARTITION_NODE DT_NODELABEL(lfs1)

#if DT_NODE_EXISTS(PARTITION_NODE)
FS_FSTAB_DECLARE_ENTRY(PARTITION_NODE);
#else /* PARTITION_NODE */
FS_LITTLEFS_DECLARE_DEFAULT_CONFIG(storage);
static struct fs_mount_t lfs_storage_mnt = {
	.type = FS_LITTLEFS,
	.fs_data = &storage,
	.storage_dev = (void *)FIXED_PARTITION_ID(storage_partition),
	.mnt_point = "/lfs",
};
#endif /* PARTITION_NODE */

	struct fs_mount_t *mountpoint =
#if DT_NODE_EXISTS(PARTITION_NODE)
		&FS_FSTAB_ENTRY(PARTITION_NODE)
#else
		&lfs_storage_mnt
#endif
		;

static int littlefs_mount(struct fs_mount_t *mp)
{
	int rc;

	rc = littlefs_flash_erase((uintptr_t)mp->storage_dev);
	if (rc < 0) {
		return rc;
	}

	/* Do not mount if auto-mount has been enabled */
#if !DT_NODE_EXISTS(PARTITION_NODE) ||						\
	!(FSTAB_ENTRY_DT_MOUNT_FLAGS(PARTITION_NODE) & FS_MOUNT_FLAG_AUTOMOUNT)
	rc = fs_mount(mp);
	if (rc < 0) {
		LOG_PRINTK("FAIL: mount id %" PRIuPTR " at %s: %d\n",
		       (uintptr_t)mp->storage_dev, mp->mnt_point, rc);
		return rc;
	}
	LOG_PRINTK("%s mount: %d\n", mp->mnt_point, rc);
#else
	LOG_PRINTK("%s automounted\n", mp->mnt_point);
#endif

	return 0;
}


int main(void)
{
	int rc;

	LOG_PRINTK("Mounting littlefs\n");

	rc = littlefs_mount(mountpoint);
	if (rc < 0) {
		LOG_PRINTK("FAIL: mount id %" PRIuPTR " at %s: %d\n",
		       (uintptr_t)mountpoint->storage_dev, mountpoint->mnt_point, rc);
		return rc;
	}
	LOG_PRINTK("%s mount: %d\n", mountpoint->mnt_point, rc);

	DIR *parent = opendir(DIRECTORY_NAME);
	if (!parent) {
		perror("opendir");
		return 1;
	}

	int dfd = dirfd(parent);
	if (dfd < 0) {
		perror("dirfd");
		return 1;
	}

	printf("got dirfd %d\n", dfd);

	int ffd = openat(dfd, "file.txt", O_RDWR | O_CREAT, 0644);
	if (ffd < 0) {
		perror("openat");
		return 1;
	}

	write(ffd, "Hello, World!", 13);
	close(ffd);

	close(dfd);


	// uname(&info);

	// printf("\nPrinting everything in utsname...\n");
	// printf("sysname[%zu]: %s\n", sizeof(info.sysname), info.sysname);
	// printf("nodename[%zu]: %s\n", sizeof(info.nodename), info.nodename);
	// printf("release[%zu]: %s\n", sizeof(info.release), info.release);
	// printf("version[%zu]: %s\n", sizeof(info.version), info.version);
	// printf("machine[%zu]: %s\n", sizeof(info.machine), info.machine);

	return 0;
}
```
